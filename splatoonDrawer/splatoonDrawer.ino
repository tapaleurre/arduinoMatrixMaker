#include <avr/pgmspace.h>
#define PRESS 9
#define DOWN 10
#define RIGHT 11
#define LEFT 12
#define UP 13
#define TIMING 45
#define SWITCH 8

const byte image[] PROGMEM={0b00000000,0b00000000,0b00000000,0b00000000,0b00000000,0b00000000,0b00000000,0b00000000,0b00000000,0b00000000,0b00000000,0b00000000,0b00000000,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0b10000000,0b00000000};
const int width = 320;
const int height = 120;
//const int width = 80;
//const int height = 2;
void press(int button){
    digitalWrite(button,LOW);
    delay(TIMING);
    digitalWrite(button,HIGH);  
  }
void pressTwo(int button1, int button2){
  delay(TIMING);
  digitalWrite(button1,LOW);
  delay(TIMING);
  digitalWrite(button1, HIGH);
  digitalWrite(button2, LOW);
  delay(TIMING);
  digitalWrite(button2,HIGH);
  
}
void sendPixel(boolean pixel, char way){
  if(pixel){
    press(PRESS);
  }else{
    delay(TIMING);
  }
  delay(TIMING);
  press(way);
  delay(TIMING);
}

void setup() {
  // put your setup code here, to run once:
  pinMode(PRESS,OUTPUT);
  pinMode(DOWN,OUTPUT);
  pinMode(RIGHT,OUTPUT);
  pinMode(LEFT,OUTPUT);
  pinMode(UP,OUTPUT);
  pinMode(SWITCH,INPUT);
  digitalWrite(PRESS,HIGH);
  digitalWrite(DOWN,HIGH);
  digitalWrite(RIGHT,HIGH);
  digitalWrite(LEFT,HIGH);
  digitalWrite(UP,HIGH);
  Serial.begin(9600);
}

void loop() {
  // put your main code here, to run repeatedly:
    /*digitalWrite(PRESS,LOW);
    delay(timing);
    digitalWrite(PRESS,HIGH);
    digitalWrite(DOWN,LOW);
    delay(timing);
    digitalWrite(DOWN,HIGH);  
    digitalWrite(RIGHT,LOW);
    delay(timing);
    digitalWrite(RIGHT,HIGH);
    digitalWrite(LEFT,LOW);
    delay(timing);
    digitalWrite(LEFT,HIGH);
    digitalWrite(UP,LOW);
    delay(timing);
    digitalWrite(UP,HIGH);*/
    if(digitalRead(SWITCH) == HIGH){
    //press(PRESS);
    //delay(2000);
    int i=0;
    int j=0;
    short k;
    int translation;
    char way = 1;
    boolean pixel=true;
    int len = height*(width/8);
    for(i=0; i< len ; i++){
        for(k = 7; 0 <= k; k--){
           /*if(way==-1){
             translation = width - i;
             pixel = (image[translation][j] << k) & 0x80;//parcours charque bit du plus lourd au plus léger
           }else{*/
             pixel = (pgm_read_byte_near(image+i) >> k) & 0b00000001;//parcours charque bit du plus lourd au plus léger
           /*}*/
           //pixel = !pixel;
           if(way == -1){
            sendPixel(pixel,LEFT);
           }else{
            sendPixel(pixel,RIGHT);
           }
      }

      j=j+8;
      if(j >= width){
        sendPixel(pixel, DOWN);
        way = -way;
        j=0;
      }
//    pixel=!pixel;
    }
   }
   delay(200);

}
